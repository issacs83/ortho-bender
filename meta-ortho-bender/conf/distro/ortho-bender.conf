## meta-ortho-bender/conf/distro/ortho-bender.conf
```bitbake
# Ortho-Bender Distribution Configuration

DISTRO = "ortho-bender"
DISTRO_NAME = "Ortho-Bender"
DISTRO_VERSION = "0.1.0"

# Base on poky
require conf/distro/poky.conf

# Distribution features
DISTRO_FEATURES:append = " systemd pam"
DISTRO_FEATURES:remove = "sysvinit"

# Use systemd as init manager
INIT_MANAGER = "systemd"

# Package management
PACKAGE_CLASSES = "package_ipk"

# Qt6 support
DISTRO_FEATURES:append = " opengl wayland"
```

## meta-ortho-bender/conf/layer.conf
```bitbake
# Layer configuration for meta-ortho-bender

BBPATH .= ":${LAYERDIR}"

BBFILES += " \
    ${LAYERDIR}/recipes-*/*/*.bb \
    ${LAYERDIR}/recipes-*/*/*.bbappend \
"

BBFILE_COLLECTIONS += "ortho-bender"
BBFILE_PATTERN_ortho-bender = "^${LAYERDIR}/"
BBFILE_PRIORITY_ortho-bender = "10"

LAYERDEPENDS_ortho-bender = "core meta-imx-bsp meta-ml qt6-layer"
LAYERSERIES_COMPAT_ortho-bender = "scarthgap"
```

## meta-ortho-bender/conf/machine/ortho-bender-imx8mp.conf
```bitbake
#@TYPE: Machine
#@NAME: Ortho-Bender Wire Bending Machine
#@SOC: i.MX8MP
#@DESCRIPTION: Custom board based on i.MX8MP for orthodontic wire bending

require conf/machine/imx8mp-lpddr4-evk.conf

# Kernel device tree
KERNEL_DEVICETREE = "freescale/imx8mp-ortho-bender.dtb"

# U-Boot config
UBOOT_CONFIG = "ortho-bender"

# M7 firmware
IMX_M7_DEMOS = "1"
M7_MACHINE = "MIMX8ML8"

# NPU support
IMX_SOC_REV_UPPER = "A1"

# Machine features
MACHINE_FEATURES += "can wifi bluetooth camera npu"

# Serial console
SERIAL_CONSOLES = "115200;ttymxc1"
```
